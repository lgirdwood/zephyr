## boards/arduino/nano_esp32s3/board.yml
```yaml
board:
  name: nano_esp32s3
  full_name: Arduino Nano ESP32S3
  vendor: arduino
  socs:
  - name: esp32s3
```

## drivers/dai/espressif/i2s/Kconfig.i2s
```kconfig
# Copyright (c) 2026 Espressif Systems / SOF Project
# SPDX-License-Identifier: Apache-2.0

config DAI_ESPRESSIF_I2S
	bool "Espressif ESP32 DAI I2S Driver"
	default y
	depends on DT_HAS_ESPRESSIF_ESP32_DAI_I2S_ENABLED
	select PINCTRL
	help
	  Enable DAI driver for Espressif ESP32 I2S controller.
```

## drivers/dai/espressif/pdm/Kconfig.pdm
```kconfig
# Copyright (c) 2026 Espressif Systems / SOF Project
# SPDX-License-Identifier: Apache-2.0

config DAI_ESPRESSIF_PDM
	bool "Espressif ESP32 DAI PDM Driver"
	default y
	depends on DT_HAS_ESPRESSIF_ESP32_DAI_PDM_ENABLED
	select PINCTRL
	help
	  Enable DAI driver for Espressif ESP32 PDM Sigma-Delta Modulator / Demodulator.
```

## drivers/dai/nxp/spdif/Kconfig.spdif
```kconfig
# Copyright 2024 NXP
# SPDX-License-Identifier: Apache-2.0

config DAI_NXP_SPDIF
	bool "NXP Sony/Philips Digital Interface (S/PDIF) driver"
	default y
	depends on DT_HAS_NXP_DAI_SPDIF_ENABLED
	select PINCTRL
	help
	  Select this to enable NXP S/PDIF driver.
```

## dts/bindings/dai/espressif,esp32-dai-i2s.yaml
```yaml
# Copyright (c) 2026 Espressif Systems / SOF Project
# SPDX-License-Identifier: Apache-2.0

description: |
  Espressif ESP32 Digital Audio Interface (DAI) for I2S controller.
  Supports Master and Slave modes, configurable word lengths, multiple channels/TDM,
  and integration with ESP32 GDMA.

compatible: "espressif,esp32-dai-i2s"

include: [base.yaml, pinctrl-device.yaml]

properties:
  reg:
    required: true

  interrupts:
    required: true

  dai-index:
    type: int
    required: true
    description: Index of this DAI interface (0 for I2S0, etc.).

  dmas:
    type: phandle-array
    description: TX and RX GDMA channels.

  dma-names:
    type: string-array
    description: Names of DMA channels ("tx", "rx").

  fifo-depth:
    type: int
    default: 32
    description: Depth of the I2S FIFO in 32-bit words.
```

## dts/bindings/dai/espressif,esp32-dai-pdm.yaml
```yaml
# Copyright (c) 2026 Espressif Systems / SOF Project
# SPDX-License-Identifier: Apache-2.0

description: |
  Espressif ESP32 Digital Audio Interface (DAI) for PDM Modulator/Demodulator.
  Supports Master and Slave modes, configurable oversampling ratios (64x/128x),
  PDM TX Sigma-Delta modulation, and PDM RX microphone decimation.

compatible: "espressif,esp32-dai-pdm"

include: [base.yaml, pinctrl-device.yaml]

properties:
  reg:
    required: true

  interrupts:
    required: true

  dai-index:
    type: int
    required: true
    description: Index of this DAI interface (1 for PDM0, 2 for PDM1, etc.).

  dmas:
    type: phandle-array
    description: TX and RX GDMA channels.

  dma-names:
    type: string-array
    description: Names of DMA channels ("tx", "rx").

  fifo-depth:
    type: int
    default: 32
    description: Depth of the PDM FIFO in 32-bit words.
```

## dts/bindings/dai/nxp,dai-spdif.yaml
```yaml
# Copyright 2024 NXP
# SPDX-License-Identifier: Apache-2.0

description: |
  NXP Sony/Philips Digital Interface (S/PDIF) audio transceiver.

compatible: "nxp,dai-spdif"

include: [base.yaml, pinctrl-device.yaml]

properties:
  reg:
    required: true
  interrupts:
    required: true
  clocks:
    required: true
  clock-names:
    required: true
  dmas:
    required: true
  dma-names:
    required: true
  dai-index:
    type: int
    description: Index of the DAI instance.
```
