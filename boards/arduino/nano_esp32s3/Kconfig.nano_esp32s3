## boards/arduino/nano_esp32s3/Kconfig.nano_esp32s3
```kconfig
# Copyright (c) 2023 Seeed Studio inc.
# SPDX-License-Identifier: Apache-2.0

config BOARD_NANO_ESP32S3
    select SOC_ESP32S3_WROOM_N16R8
    select SOC_ESP32S3_PROCPU if BOARD_NANO_ESP32S3_PROCPU
    select SOC_ESP32S3_APPCPU if BOARD_NANO_ESP32S3_APPCPU
```

## drivers/sensor/melexis/mlx90614/Kconfig
```kconfig
# MLX90614 temperature sensor config

# SPDX-License-Identifier: Apache-2.0

config MLX90614
	bool "MLX90614 Temperature Sensor"
	default y
	depends on DT_HAS_MELEXIS_MLX90614_ENABLED
	select I2C
	help
	  Enable the driver for the MLX90614 digital temperature Sensor with 2-wire
	  interface.
```

## drivers/sensor/samesky/Kconfig
```kconfig
# SPDX-License-Identifier: Apache-2.0

# zephyr-keep-sorted-start
source "drivers/sensor/samesky/amt2xx/Kconfig"
# zephyr-keep-sorted-stop
```

## drivers/sensor/samesky/amt2xx/Kconfig
```kconfig
# AMT2XX temperature sensor config

# SPDX-License-Identifier: Apache-2.0

config AMT2XX
	bool "AMT2xx Position Sensor"
	default y
	depends on DT_HAS_SAMESKY_AMT2XX_ENABLED
	select SPI
	help
	  Enable the driver for the AMT2xx position Sensor with SPI
	  interface.
```

## dts/bindings/sensor/melexis,mlx90614.yaml
```yaml
# SPDX-License-Identifier: Apache-2.0

description: MLX90614 Digital Temperature Sensor with 2-Wire Interface.

compatible: "melexis,mlx90614"

include: [sensor-device.yaml, i2c-device.yaml]
```

## dts/bindings/sensor/samesky,amt2xx.yaml
```yaml
# SPDX-License-Identifier: Apache-2.0

description: AMT2xx Digital Position Sensor with SPI Interface.

compatible: "samesky,amt2xx"

include: [sensor-device.yaml, spi-device.yaml]

properties:

  cs-gpios:
    type: phandle-array
    description:
      Driver controlled CS output.
```

## modules/Kconfig.intel_adsp
```kconfig
# Copyright (c) 2020 Intel Corporation
# SPDX-License-Identifier: Apache-2.0

config INTEL_ADSP_HAL
	bool
	help
	  Build the Intel ADSP HAL module during build process.
	  This is selected by any Intel ADSP board kconfig automatically.

config INTEL_ADSP_HAL_CAVS
	bool
	help
		Intel CAVS support
```

## soc/xtensa/intel_adsp_common/Kconfig
```kconfig
# Copyright (c) 2017 Intel Corporation
# SPDX-License-Identifier: Apache-2.0


config CAVS_ADSP_COMMON
	bool "Common Shared logic for CAVS IP"
	default n

config CAVS_VERSION_1_5
	bool "Support for Intel ADSP CAVS IP version 1.5"
	default n
	help
	  Supports Skylake, Kabylake, Apollolake and Geminilake audio DSP hardware

config CAVS_VERSION_1_8
	bool "Support for Intel ADSP CAVS IP version 1.8"
	default n
	help
	  Supports Cannonlake, Icelake, and Sue Creek audio DSP hardware

config CAVS_VERSION_2_0
	bool "Support for Intel ADSP CAVS IP version 2.0"
	default n
	help
	  Supports Cometlake, Jasperlake audio DSP hardware

config CAVS_VERSION_2_5
	bool "Support for Intel ADSP CAVS IP version 2.5"
	default n
    help
	  Supports Tigerlake audio DSP hardware
```
